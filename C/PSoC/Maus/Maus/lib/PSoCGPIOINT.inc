;  Generated by PSoC Designer 5.2.2551
;
; Poti address and mask equates
Poti_Data_ADDR:	equ	0h
Poti_DriveMode_0_ADDR:	equ	100h
Poti_DriveMode_1_ADDR:	equ	101h
Poti_DriveMode_2_ADDR:	equ	3h
Poti_GlobalSelect_ADDR:	equ	2h
Poti_IntCtrl_0_ADDR:	equ	102h
Poti_IntCtrl_1_ADDR:	equ	103h
Poti_IntEn_ADDR:	equ	1h
Poti_MASK:	equ	2h
Poti_MUXBusCtrl_ADDR:	equ	1d8h
; Taster address and mask equates
Taster_Data_ADDR:	equ	4h
Taster_DriveMode_0_ADDR:	equ	104h
Taster_DriveMode_1_ADDR:	equ	105h
Taster_DriveMode_2_ADDR:	equ	7h
Taster_GlobalSelect_ADDR:	equ	6h
Taster_IntCtrl_0_ADDR:	equ	106h
Taster_IntCtrl_1_ADDR:	equ	107h
Taster_IntEn_ADDR:	equ	5h
Taster_MASK:	equ	10h
Taster_MUXBusCtrl_ADDR:	equ	1d9h
; Taster_Data access macros
;   GetTaster_Data macro, return in a
macro GetTaster_Data
	mov		a,[Port_1_Data_SHADE]
	and		a, 10h
endm
;   SetTaster_Data macro
macro SetTaster_Data
	or		[Port_1_Data_SHADE], 10h
	mov		a, [Port_1_Data_SHADE]
	mov		reg[Taster_Data_ADDR], a
endm
;   ClearTaster_Data macro
macro ClearTaster_Data
	and		[Port_1_Data_SHADE], ~10h
	mov		a, [Port_1_Data_SHADE]
	mov		reg[Taster_Data_ADDR], a
endm

