;;*****************************************************************************
;;*****************************************************************************
;;  FILENAME: Timer8.inc
;;   Version: 2.70, Updated on 2011/12/1 at 17:23:25
;;  Generated by PSoC Designer 5.2.2401
;;
;;  DESCRIPTION: Assembler declarations for the Timer8 user module interface
;;-----------------------------------------------------------------------------
;;  Copyright (c) Cypress Semiconductor 2011. All Rights Reserved.
;;*****************************************************************************
;;*****************************************************************************

include "m8c.inc"


;--------------------------------------------------
; Constants for Timer8 API's.
;--------------------------------------------------

Timer8_CONTROL_REG_START_BIT:              equ 0x01    ; Control register start bit
Timer8_INT_REG:                            equ 0x0e1
Timer8_INT_MASK:                           equ 0x08


;--------------------------------------------------
; Constants for Timer8 user defined values
;--------------------------------------------------

Timer8_PERIOD:                             equ 0xff
Timer8_COMPARE_VALUE:                      equ 0x00


;--------------------------------------------------
; Register Address Constants for Timer8
;--------------------------------------------------

Timer8_COUNTER_REG:                    equ 0x2c   ; DR0 Counter register
Timer8_PERIOD_REG:                     equ 0x2d   ; DR1 Period register
Timer8_COMPARE_REG:                    equ 0x2e   ; DR2 CompareValue register
Timer8_CONTROL_REG:                    equ 0x2f   ; Control register
Timer8_FUNC_REG:                       equ 0x2c   ; Function register
Timer8_INPUT_REG:                      equ 0x2d   ; Input register
Timer8_OUTPUT_REG:                     equ 0x2e   ; Output register


;--------------------------------------------------
; Timer8 Macro 'Functions'
;--------------------------------------------------

   macro Timer8_Start_M
   or    reg[Timer8_CONTROL_REG],  Timer8_CONTROL_REG_START_BIT
   endm

   macro Timer8_Stop_M
   and   reg[Timer8_CONTROL_REG], ~Timer8_CONTROL_REG_START_BIT
   endm

   macro Timer8_EnableInt_M
   M8C_EnableIntMask Timer8_INT_REG, Timer8_INT_MASK
   endm

   macro Timer8_DisableInt_M
   M8C_DisableIntMask Timer8_INT_REG, Timer8_INT_MASK
   endm


; end of file Timer8.inc
