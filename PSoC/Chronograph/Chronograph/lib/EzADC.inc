;;*****************************************************************************
;;*****************************************************************************
;;  FILENAME: EzADC.inc
;;  Version: 1.00, Updated on 2012/9/21 at 11:59:1
;;  Generated by PSoC Designer 5.3.2710
;;
;;  DESCRIPTION: Assembler declarations for the EzADC A/D Converter
;;               User Module with a 1st-order modulator.
;;-----------------------------------------------------------------------------
;;  Copyright (c) Cypress Semiconductor 2012. All Rights Reserved.
;;*****************************************************************************
;;*****************************************************************************

include "m8c.inc"
include "memory.inc"
;--------------------------------------------------
; Constants for EzADC API's.
;--------------------------------------------------

EzADC_OFF:                     equ 00h
EzADC_LOWPOWER:                equ 01h
EzADC_MEDPOWER:                equ 02h
EzADC_HIGHPOWER:               equ 03h

EzADC_G48_0:                   equ 0Ch
EzADC_G24_0:                   equ 1Ch
EzADC_G16_0:                   equ 08h
EzADC_G8_00:                   equ 18h
EzADC_G5_33:                   equ 28h
EzADC_G4_00:                   equ 38h
EzADC_G3_20:                   equ 48h
EzADC_G2_67:                   equ 58h
EzADC_G2_27:                   equ 68h
EzADC_G2_00:                   equ 78h
EzADC_G1_78:                   equ 88h
EzADC_G1_60:                   equ 98h
EzADC_G1_46:                   equ A8h
EzADC_G1_33:                   equ B8h
EzADC_G1_23:                   equ C8h
EzADC_G1_14:                   equ D8h
EzADC_G1_06:                   equ E8h
EzADC_G1_00:                   equ F8h

EzADC_REF_VSS:                 equ 10h
EzADC_REF_AGND:                equ 01h

EzADC_bNUMBITS:                           equ 08h
EzADC_NoAZ:                               equ 1
EzADC_SIGNED_DATA:                        equ 1
EzADC_9_OR_MORE_BITS:                     equ ((08h - 1)& 08h)
EzADC_8_OR_MORE_BITS:                     equ ((08h )& 08h)
EzADC_OFFSET_COMPENSATION:                equ 0
EzADC_OFFSET_COMPENSATION_FREQUENCY:      equ 7fh
EzADC_USER_DEF_INPUT_ADC:                 equ 0
EzADC_OC_CNT_SIZE_IS_TWO_BYTE:            equ 0
EzADC_TEST_MUX_ENABLE:                    equ 0

;--------------------------------------------------
; Register Address Constants for EzADC
;--------------------------------------------------
EzADC_ISR_MASK:                        equ 20h
EzADC_ISR_REG:                         equ 0e1h
EzADC_CLR_REG:                         equ (((EzADC_ISR_REG & 038h)/8)^0dfh)

EzADC_PWMdr0:                  equ 34h     ; Period reg
EzADC_PWMdr1:                  equ 35h     ; Down count reg
EzADC_PWMdr2:                  equ 36h     ; Compare reg
EzADC_PWMcr0:                  equ 37h     ; Control reg
EzADC_PWMfn:                   equ 34h     ; Function reg
EzADC_PWMsl:                   equ 35h     ; Input  select reg
EzADC_PWMos:                   equ 36h     ; Output select reg

EzADC_AtoDcr0:                 equ 80h     ; SC Block Control Reg 0
EzADC_AtoDcr1:                 equ 81h     ; SC Block Control Reg 1
EzADC_AtoDcr2:                 equ 82h     ; SC Block Control Reg 2
EzADC_AtoDcr3:                 equ 83h     ; SC Block Control Reg 3

EzADC_GAINcr0:                 equ 71h     ; CT Block Control Reg 0
EzADC_GAINcr1:                 equ 72h     ; CT Block Control Reg 1
EzADC_GAINcr2:                 equ 73h     ; CT Block Control Reg 2
EzADC_GAINcr3:                 equ 70h     ; CT Block Control Reg 3

EzADC_CNTdr0:                  equ 30h     ; Period reg
EzADC_CNTdr1:                  equ 31h     ; Down count reg
EzADC_CNTdr2:                  equ 32h     ; Compare reg
EzADC_CNTcr0:                  equ 33h     ; Control reg
EzADC_CNTfn:                   equ 30h     ; Function reg
EzADC_CNTsl:                   equ 31h     ; Input  select reg
EzADC_CNTos:                   equ 32h     ; Output select reg

HighByte: equ 0
LowByte:  equ 1

macro EzADC_fIsDataAvailable_M
   RAM_SETPAGE_CUR >EzADC_fStatus
   mov A,[EzADC_fStatus]
endm

macro EzADC_iClearFlagGetData_M
   RAM_SETPAGE_CUR >EzADC_fStatus
  .repeat:
      mov [EzADC_fStatus],00h
      mov X,[(EzADC_iResult + HighByte)]
      mov A,[(EzADC_iResult + LowByte)]
      cmp [EzADC_fStatus],00h
  .until: jnz .repeat
endm

macro EzADC_ENABLE_INTEGRATOR_M  
   and reg[EzADC_AtoDcr3],~10h
   IF EzADC_NoAZ
   and reg[EzADC_AtoDcr2],~20h
   ENDIF
endm

macro EzADC_RESET_INTEGRATOR_M  
   IF EzADC_NoAZ
   or  reg[EzADC_AtoDcr2],20h
   ENDIF
   or  reg[EzADC_AtoDcr3],10h
endm

macro EzADC_STARTADC_M  
   ;Enable PWM interrupt
   mov reg[EzADC_CLR_REG],~(EzADC_ISR_MASK)
   or  reg[EzADC_ISR_REG], (EzADC_ISR_MASK)
endm

macro EzADC_STOPADC_M
   ;Disable PWM interrupt  
   and reg[EzADC_ISR_REG],~(EzADC_ISR_MASK)
endm

; end of file EzADC.inc
