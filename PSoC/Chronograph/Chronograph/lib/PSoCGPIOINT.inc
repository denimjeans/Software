;  Generated by PSoC Designer 5.3.2710
;
; LCDD4 address and mask equates
LCDD4_Data_ADDR:	equ	0h
LCDD4_DriveMode_0_ADDR:	equ	100h
LCDD4_DriveMode_1_ADDR:	equ	101h
LCDD4_DriveMode_2_ADDR:	equ	3h
LCDD4_GlobalSelect_ADDR:	equ	2h
LCDD4_IntCtrl_0_ADDR:	equ	102h
LCDD4_IntCtrl_1_ADDR:	equ	103h
LCDD4_IntEn_ADDR:	equ	1h
LCDD4_MASK:	equ	1h
; LCDD4_Data access macros
;   GetLCDD4_Data macro, return in a
macro GetLCDD4_Data
	mov		a,[Port_0_Data_SHADE]
	and		a, 1h
endm
;   SetLCDD4_Data macro
macro SetLCDD4_Data
	or		[Port_0_Data_SHADE], 1h
	mov		a, [Port_0_Data_SHADE]
	mov		reg[LCDD4_Data_ADDR], a
endm
;   ClearLCDD4_Data macro
macro ClearLCDD4_Data
	and		[Port_0_Data_SHADE], ~1h
	mov		a, [Port_0_Data_SHADE]
	mov		reg[LCDD4_Data_ADDR], a
endm

; LCDD4_DriveMode_0 access macros
;   GetLCDD4_DriveMode_0 macro, return in a
macro GetLCDD4_DriveMode_0
	mov		a,[Port_0_DriveMode_0_SHADE]
	and		a, 1h
endm
;   SetLCDD4_DriveMode_0 macro
macro SetLCDD4_DriveMode_0
	or		[Port_0_DriveMode_0_SHADE], 1h
	mov		a, [Port_0_DriveMode_0_SHADE]
	mov		reg[LCDD4_Data_ADDR], a
endm
;   ClearLCDD4_DriveMode_0 macro
macro ClearLCDD4_DriveMode_0
	and		[Port_0_DriveMode_0_SHADE], ~1h
	mov		a, [Port_0_DriveMode_0_SHADE]
	mov		reg[LCDD4_Data_ADDR], a
endm

; LCDD4_DriveMode_1 access macros
;   GetLCDD4_DriveMode_1 macro, return in a
macro GetLCDD4_DriveMode_1
	mov		a,[Port_0_DriveMode_1_SHADE]
	and		a, 1h
endm
;   SetLCDD4_DriveMode_1 macro
macro SetLCDD4_DriveMode_1
	or		[Port_0_DriveMode_1_SHADE], 1h
	mov		a, [Port_0_DriveMode_1_SHADE]
	mov		reg[LCDD4_Data_ADDR], a
endm
;   ClearLCDD4_DriveMode_1 macro
macro ClearLCDD4_DriveMode_1
	and		[Port_0_DriveMode_1_SHADE], ~1h
	mov		a, [Port_0_DriveMode_1_SHADE]
	mov		reg[LCDD4_Data_ADDR], a
endm

; LCDD5 address and mask equates
LCDD5_Data_ADDR:	equ	0h
LCDD5_DriveMode_0_ADDR:	equ	100h
LCDD5_DriveMode_1_ADDR:	equ	101h
LCDD5_DriveMode_2_ADDR:	equ	3h
LCDD5_GlobalSelect_ADDR:	equ	2h
LCDD5_IntCtrl_0_ADDR:	equ	102h
LCDD5_IntCtrl_1_ADDR:	equ	103h
LCDD5_IntEn_ADDR:	equ	1h
LCDD5_MASK:	equ	2h
; LCDD5_Data access macros
;   GetLCDD5_Data macro, return in a
macro GetLCDD5_Data
	mov		a,[Port_0_Data_SHADE]
	and		a, 2h
endm
;   SetLCDD5_Data macro
macro SetLCDD5_Data
	or		[Port_0_Data_SHADE], 2h
	mov		a, [Port_0_Data_SHADE]
	mov		reg[LCDD5_Data_ADDR], a
endm
;   ClearLCDD5_Data macro
macro ClearLCDD5_Data
	and		[Port_0_Data_SHADE], ~2h
	mov		a, [Port_0_Data_SHADE]
	mov		reg[LCDD5_Data_ADDR], a
endm

; LCDD5_DriveMode_0 access macros
;   GetLCDD5_DriveMode_0 macro, return in a
macro GetLCDD5_DriveMode_0
	mov		a,[Port_0_DriveMode_0_SHADE]
	and		a, 2h
endm
;   SetLCDD5_DriveMode_0 macro
macro SetLCDD5_DriveMode_0
	or		[Port_0_DriveMode_0_SHADE], 2h
	mov		a, [Port_0_DriveMode_0_SHADE]
	mov		reg[LCDD5_Data_ADDR], a
endm
;   ClearLCDD5_DriveMode_0 macro
macro ClearLCDD5_DriveMode_0
	and		[Port_0_DriveMode_0_SHADE], ~2h
	mov		a, [Port_0_DriveMode_0_SHADE]
	mov		reg[LCDD5_Data_ADDR], a
endm

; LCDD5_DriveMode_1 access macros
;   GetLCDD5_DriveMode_1 macro, return in a
macro GetLCDD5_DriveMode_1
	mov		a,[Port_0_DriveMode_1_SHADE]
	and		a, 2h
endm
;   SetLCDD5_DriveMode_1 macro
macro SetLCDD5_DriveMode_1
	or		[Port_0_DriveMode_1_SHADE], 2h
	mov		a, [Port_0_DriveMode_1_SHADE]
	mov		reg[LCDD5_Data_ADDR], a
endm
;   ClearLCDD5_DriveMode_1 macro
macro ClearLCDD5_DriveMode_1
	and		[Port_0_DriveMode_1_SHADE], ~2h
	mov		a, [Port_0_DriveMode_1_SHADE]
	mov		reg[LCDD5_Data_ADDR], a
endm

; LCDD6 address and mask equates
LCDD6_Data_ADDR:	equ	0h
LCDD6_DriveMode_0_ADDR:	equ	100h
LCDD6_DriveMode_1_ADDR:	equ	101h
LCDD6_DriveMode_2_ADDR:	equ	3h
LCDD6_GlobalSelect_ADDR:	equ	2h
LCDD6_IntCtrl_0_ADDR:	equ	102h
LCDD6_IntCtrl_1_ADDR:	equ	103h
LCDD6_IntEn_ADDR:	equ	1h
LCDD6_MASK:	equ	4h
; LCDD6_Data access macros
;   GetLCDD6_Data macro, return in a
macro GetLCDD6_Data
	mov		a,[Port_0_Data_SHADE]
	and		a, 4h
endm
;   SetLCDD6_Data macro
macro SetLCDD6_Data
	or		[Port_0_Data_SHADE], 4h
	mov		a, [Port_0_Data_SHADE]
	mov		reg[LCDD6_Data_ADDR], a
endm
;   ClearLCDD6_Data macro
macro ClearLCDD6_Data
	and		[Port_0_Data_SHADE], ~4h
	mov		a, [Port_0_Data_SHADE]
	mov		reg[LCDD6_Data_ADDR], a
endm

; LCDD6_DriveMode_0 access macros
;   GetLCDD6_DriveMode_0 macro, return in a
macro GetLCDD6_DriveMode_0
	mov		a,[Port_0_DriveMode_0_SHADE]
	and		a, 4h
endm
;   SetLCDD6_DriveMode_0 macro
macro SetLCDD6_DriveMode_0
	or		[Port_0_DriveMode_0_SHADE], 4h
	mov		a, [Port_0_DriveMode_0_SHADE]
	mov		reg[LCDD6_Data_ADDR], a
endm
;   ClearLCDD6_DriveMode_0 macro
macro ClearLCDD6_DriveMode_0
	and		[Port_0_DriveMode_0_SHADE], ~4h
	mov		a, [Port_0_DriveMode_0_SHADE]
	mov		reg[LCDD6_Data_ADDR], a
endm

; LCDD6_DriveMode_1 access macros
;   GetLCDD6_DriveMode_1 macro, return in a
macro GetLCDD6_DriveMode_1
	mov		a,[Port_0_DriveMode_1_SHADE]
	and		a, 4h
endm
;   SetLCDD6_DriveMode_1 macro
macro SetLCDD6_DriveMode_1
	or		[Port_0_DriveMode_1_SHADE], 4h
	mov		a, [Port_0_DriveMode_1_SHADE]
	mov		reg[LCDD6_Data_ADDR], a
endm
;   ClearLCDD6_DriveMode_1 macro
macro ClearLCDD6_DriveMode_1
	and		[Port_0_DriveMode_1_SHADE], ~4h
	mov		a, [Port_0_DriveMode_1_SHADE]
	mov		reg[LCDD6_Data_ADDR], a
endm

; LCDD7 address and mask equates
LCDD7_Data_ADDR:	equ	0h
LCDD7_DriveMode_0_ADDR:	equ	100h
LCDD7_DriveMode_1_ADDR:	equ	101h
LCDD7_DriveMode_2_ADDR:	equ	3h
LCDD7_GlobalSelect_ADDR:	equ	2h
LCDD7_IntCtrl_0_ADDR:	equ	102h
LCDD7_IntCtrl_1_ADDR:	equ	103h
LCDD7_IntEn_ADDR:	equ	1h
LCDD7_MASK:	equ	8h
; LCDD7_Data access macros
;   GetLCDD7_Data macro, return in a
macro GetLCDD7_Data
	mov		a,[Port_0_Data_SHADE]
	and		a, 8h
endm
;   SetLCDD7_Data macro
macro SetLCDD7_Data
	or		[Port_0_Data_SHADE], 8h
	mov		a, [Port_0_Data_SHADE]
	mov		reg[LCDD7_Data_ADDR], a
endm
;   ClearLCDD7_Data macro
macro ClearLCDD7_Data
	and		[Port_0_Data_SHADE], ~8h
	mov		a, [Port_0_Data_SHADE]
	mov		reg[LCDD7_Data_ADDR], a
endm

; LCDD7_DriveMode_0 access macros
;   GetLCDD7_DriveMode_0 macro, return in a
macro GetLCDD7_DriveMode_0
	mov		a,[Port_0_DriveMode_0_SHADE]
	and		a, 8h
endm
;   SetLCDD7_DriveMode_0 macro
macro SetLCDD7_DriveMode_0
	or		[Port_0_DriveMode_0_SHADE], 8h
	mov		a, [Port_0_DriveMode_0_SHADE]
	mov		reg[LCDD7_Data_ADDR], a
endm
;   ClearLCDD7_DriveMode_0 macro
macro ClearLCDD7_DriveMode_0
	and		[Port_0_DriveMode_0_SHADE], ~8h
	mov		a, [Port_0_DriveMode_0_SHADE]
	mov		reg[LCDD7_Data_ADDR], a
endm

; LCDD7_DriveMode_1 access macros
;   GetLCDD7_DriveMode_1 macro, return in a
macro GetLCDD7_DriveMode_1
	mov		a,[Port_0_DriveMode_1_SHADE]
	and		a, 8h
endm
;   SetLCDD7_DriveMode_1 macro
macro SetLCDD7_DriveMode_1
	or		[Port_0_DriveMode_1_SHADE], 8h
	mov		a, [Port_0_DriveMode_1_SHADE]
	mov		reg[LCDD7_Data_ADDR], a
endm
;   ClearLCDD7_DriveMode_1 macro
macro ClearLCDD7_DriveMode_1
	and		[Port_0_DriveMode_1_SHADE], ~8h
	mov		a, [Port_0_DriveMode_1_SHADE]
	mov		reg[LCDD7_Data_ADDR], a
endm

; LCDE address and mask equates
LCDE_Data_ADDR:	equ	0h
LCDE_DriveMode_0_ADDR:	equ	100h
LCDE_DriveMode_1_ADDR:	equ	101h
LCDE_DriveMode_2_ADDR:	equ	3h
LCDE_GlobalSelect_ADDR:	equ	2h
LCDE_IntCtrl_0_ADDR:	equ	102h
LCDE_IntCtrl_1_ADDR:	equ	103h
LCDE_IntEn_ADDR:	equ	1h
LCDE_MASK:	equ	10h
; LCDE_Data access macros
;   GetLCDE_Data macro, return in a
macro GetLCDE_Data
	mov		a,[Port_0_Data_SHADE]
	and		a, 10h
endm
;   SetLCDE_Data macro
macro SetLCDE_Data
	or		[Port_0_Data_SHADE], 10h
	mov		a, [Port_0_Data_SHADE]
	mov		reg[LCDE_Data_ADDR], a
endm
;   ClearLCDE_Data macro
macro ClearLCDE_Data
	and		[Port_0_Data_SHADE], ~10h
	mov		a, [Port_0_Data_SHADE]
	mov		reg[LCDE_Data_ADDR], a
endm

; LCDE_DriveMode_0 access macros
;   GetLCDE_DriveMode_0 macro, return in a
macro GetLCDE_DriveMode_0
	mov		a,[Port_0_DriveMode_0_SHADE]
	and		a, 10h
endm
;   SetLCDE_DriveMode_0 macro
macro SetLCDE_DriveMode_0
	or		[Port_0_DriveMode_0_SHADE], 10h
	mov		a, [Port_0_DriveMode_0_SHADE]
	mov		reg[LCDE_Data_ADDR], a
endm
;   ClearLCDE_DriveMode_0 macro
macro ClearLCDE_DriveMode_0
	and		[Port_0_DriveMode_0_SHADE], ~10h
	mov		a, [Port_0_DriveMode_0_SHADE]
	mov		reg[LCDE_Data_ADDR], a
endm

; LCDE_DriveMode_1 access macros
;   GetLCDE_DriveMode_1 macro, return in a
macro GetLCDE_DriveMode_1
	mov		a,[Port_0_DriveMode_1_SHADE]
	and		a, 10h
endm
;   SetLCDE_DriveMode_1 macro
macro SetLCDE_DriveMode_1
	or		[Port_0_DriveMode_1_SHADE], 10h
	mov		a, [Port_0_DriveMode_1_SHADE]
	mov		reg[LCDE_Data_ADDR], a
endm
;   ClearLCDE_DriveMode_1 macro
macro ClearLCDE_DriveMode_1
	and		[Port_0_DriveMode_1_SHADE], ~10h
	mov		a, [Port_0_DriveMode_1_SHADE]
	mov		reg[LCDE_Data_ADDR], a
endm

; LCDRS address and mask equates
LCDRS_Data_ADDR:	equ	0h
LCDRS_DriveMode_0_ADDR:	equ	100h
LCDRS_DriveMode_1_ADDR:	equ	101h
LCDRS_DriveMode_2_ADDR:	equ	3h
LCDRS_GlobalSelect_ADDR:	equ	2h
LCDRS_IntCtrl_0_ADDR:	equ	102h
LCDRS_IntCtrl_1_ADDR:	equ	103h
LCDRS_IntEn_ADDR:	equ	1h
LCDRS_MASK:	equ	20h
; LCDRS_Data access macros
;   GetLCDRS_Data macro, return in a
macro GetLCDRS_Data
	mov		a,[Port_0_Data_SHADE]
	and		a, 20h
endm
;   SetLCDRS_Data macro
macro SetLCDRS_Data
	or		[Port_0_Data_SHADE], 20h
	mov		a, [Port_0_Data_SHADE]
	mov		reg[LCDRS_Data_ADDR], a
endm
;   ClearLCDRS_Data macro
macro ClearLCDRS_Data
	and		[Port_0_Data_SHADE], ~20h
	mov		a, [Port_0_Data_SHADE]
	mov		reg[LCDRS_Data_ADDR], a
endm

; LCDRS_DriveMode_0 access macros
;   GetLCDRS_DriveMode_0 macro, return in a
macro GetLCDRS_DriveMode_0
	mov		a,[Port_0_DriveMode_0_SHADE]
	and		a, 20h
endm
;   SetLCDRS_DriveMode_0 macro
macro SetLCDRS_DriveMode_0
	or		[Port_0_DriveMode_0_SHADE], 20h
	mov		a, [Port_0_DriveMode_0_SHADE]
	mov		reg[LCDRS_Data_ADDR], a
endm
;   ClearLCDRS_DriveMode_0 macro
macro ClearLCDRS_DriveMode_0
	and		[Port_0_DriveMode_0_SHADE], ~20h
	mov		a, [Port_0_DriveMode_0_SHADE]
	mov		reg[LCDRS_Data_ADDR], a
endm

; LCDRS_DriveMode_1 access macros
;   GetLCDRS_DriveMode_1 macro, return in a
macro GetLCDRS_DriveMode_1
	mov		a,[Port_0_DriveMode_1_SHADE]
	and		a, 20h
endm
;   SetLCDRS_DriveMode_1 macro
macro SetLCDRS_DriveMode_1
	or		[Port_0_DriveMode_1_SHADE], 20h
	mov		a, [Port_0_DriveMode_1_SHADE]
	mov		reg[LCDRS_Data_ADDR], a
endm
;   ClearLCDRS_DriveMode_1 macro
macro ClearLCDRS_DriveMode_1
	and		[Port_0_DriveMode_1_SHADE], ~20h
	mov		a, [Port_0_DriveMode_1_SHADE]
	mov		reg[LCDRS_Data_ADDR], a
endm

; LCDRW address and mask equates
LCDRW_Data_ADDR:	equ	0h
LCDRW_DriveMode_0_ADDR:	equ	100h
LCDRW_DriveMode_1_ADDR:	equ	101h
LCDRW_DriveMode_2_ADDR:	equ	3h
LCDRW_GlobalSelect_ADDR:	equ	2h
LCDRW_IntCtrl_0_ADDR:	equ	102h
LCDRW_IntCtrl_1_ADDR:	equ	103h
LCDRW_IntEn_ADDR:	equ	1h
LCDRW_MASK:	equ	40h
; LCDRW_Data access macros
;   GetLCDRW_Data macro, return in a
macro GetLCDRW_Data
	mov		a,[Port_0_Data_SHADE]
	and		a, 40h
endm
;   SetLCDRW_Data macro
macro SetLCDRW_Data
	or		[Port_0_Data_SHADE], 40h
	mov		a, [Port_0_Data_SHADE]
	mov		reg[LCDRW_Data_ADDR], a
endm
;   ClearLCDRW_Data macro
macro ClearLCDRW_Data
	and		[Port_0_Data_SHADE], ~40h
	mov		a, [Port_0_Data_SHADE]
	mov		reg[LCDRW_Data_ADDR], a
endm

; LCDRW_DriveMode_0 access macros
;   GetLCDRW_DriveMode_0 macro, return in a
macro GetLCDRW_DriveMode_0
	mov		a,[Port_0_DriveMode_0_SHADE]
	and		a, 40h
endm
;   SetLCDRW_DriveMode_0 macro
macro SetLCDRW_DriveMode_0
	or		[Port_0_DriveMode_0_SHADE], 40h
	mov		a, [Port_0_DriveMode_0_SHADE]
	mov		reg[LCDRW_Data_ADDR], a
endm
;   ClearLCDRW_DriveMode_0 macro
macro ClearLCDRW_DriveMode_0
	and		[Port_0_DriveMode_0_SHADE], ~40h
	mov		a, [Port_0_DriveMode_0_SHADE]
	mov		reg[LCDRW_Data_ADDR], a
endm

; LCDRW_DriveMode_1 access macros
;   GetLCDRW_DriveMode_1 macro, return in a
macro GetLCDRW_DriveMode_1
	mov		a,[Port_0_DriveMode_1_SHADE]
	and		a, 40h
endm
;   SetLCDRW_DriveMode_1 macro
macro SetLCDRW_DriveMode_1
	or		[Port_0_DriveMode_1_SHADE], 40h
	mov		a, [Port_0_DriveMode_1_SHADE]
	mov		reg[LCDRW_Data_ADDR], a
endm
;   ClearLCDRW_DriveMode_1 macro
macro ClearLCDRW_DriveMode_1
	and		[Port_0_DriveMode_1_SHADE], ~40h
	mov		a, [Port_0_DriveMode_1_SHADE]
	mov		reg[LCDRW_Data_ADDR], a
endm

