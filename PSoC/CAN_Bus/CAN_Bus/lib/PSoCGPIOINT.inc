;  Generated by PSoC Designer 5.2.2401
;
; MISO address and mask equates
MISO_Data_ADDR:	equ	0h
MISO_DriveMode_0_ADDR:	equ	100h
MISO_DriveMode_1_ADDR:	equ	101h
MISO_DriveMode_2_ADDR:	equ	3h
MISO_GlobalSelect_ADDR:	equ	2h
MISO_IntCtrl_0_ADDR:	equ	102h
MISO_IntCtrl_1_ADDR:	equ	103h
MISO_IntEn_ADDR:	equ	1h
MISO_MASK:	equ	1h
; MISO_Data access macros
;   GetMISO_Data macro, return in a
macro GetMISO_Data
	mov		a,[Port_0_Data_SHADE]
	and		a, 1h
endm
;   SetMISO_Data macro
macro SetMISO_Data
	or		[Port_0_Data_SHADE], 1h
	mov		a, [Port_0_Data_SHADE]
	mov		reg[MISO_Data_ADDR], a
endm
;   ClearMISO_Data macro
macro ClearMISO_Data
	and		[Port_0_Data_SHADE], ~1h
	mov		a, [Port_0_Data_SHADE]
	mov		reg[MISO_Data_ADDR], a
endm

; Chipselect address and mask equates
Chipselect_Data_ADDR:	equ	0h
Chipselect_DriveMode_0_ADDR:	equ	100h
Chipselect_DriveMode_1_ADDR:	equ	101h
Chipselect_DriveMode_2_ADDR:	equ	3h
Chipselect_GlobalSelect_ADDR:	equ	2h
Chipselect_IntCtrl_0_ADDR:	equ	102h
Chipselect_IntCtrl_1_ADDR:	equ	103h
Chipselect_IntEn_ADDR:	equ	1h
Chipselect_MASK:	equ	2h
; Chipselect_Data access macros
;   GetChipselect_Data macro, return in a
macro GetChipselect_Data
	mov		a,[Port_0_Data_SHADE]
	and		a, 2h
endm
;   SetChipselect_Data macro
macro SetChipselect_Data
	or		[Port_0_Data_SHADE], 2h
	mov		a, [Port_0_Data_SHADE]
	mov		reg[Chipselect_Data_ADDR], a
endm
;   ClearChipselect_Data macro
macro ClearChipselect_Data
	and		[Port_0_Data_SHADE], ~2h
	mov		a, [Port_0_Data_SHADE]
	mov		reg[Chipselect_Data_ADDR], a
endm

; UART_Tx address and mask equates
UART_Tx_Data_ADDR:	equ	0h
UART_Tx_DriveMode_0_ADDR:	equ	100h
UART_Tx_DriveMode_1_ADDR:	equ	101h
UART_Tx_DriveMode_2_ADDR:	equ	3h
UART_Tx_GlobalSelect_ADDR:	equ	2h
UART_Tx_IntCtrl_0_ADDR:	equ	102h
UART_Tx_IntCtrl_1_ADDR:	equ	103h
UART_Tx_IntEn_ADDR:	equ	1h
UART_Tx_MASK:	equ	80h
; UART_Tx_Data access macros
;   GetUART_Tx_Data macro, return in a
macro GetUART_Tx_Data
	mov		a,[Port_0_Data_SHADE]
	and		a, 80h
endm
;   SetUART_Tx_Data macro
macro SetUART_Tx_Data
	or		[Port_0_Data_SHADE], 80h
	mov		a, [Port_0_Data_SHADE]
	mov		reg[UART_Tx_Data_ADDR], a
endm
;   ClearUART_Tx_Data macro
macro ClearUART_Tx_Data
	and		[Port_0_Data_SHADE], ~80h
	mov		a, [Port_0_Data_SHADE]
	mov		reg[UART_Tx_Data_ADDR], a
endm

; MOSI address and mask equates
MOSI_Data_ADDR:	equ	8h
MOSI_DriveMode_0_ADDR:	equ	108h
MOSI_DriveMode_1_ADDR:	equ	109h
MOSI_DriveMode_2_ADDR:	equ	bh
MOSI_GlobalSelect_ADDR:	equ	ah
MOSI_IntCtrl_0_ADDR:	equ	10ah
MOSI_IntCtrl_1_ADDR:	equ	10bh
MOSI_IntEn_ADDR:	equ	9h
MOSI_MASK:	equ	1h
; SCK address and mask equates
SCK_Data_ADDR:	equ	8h
SCK_DriveMode_0_ADDR:	equ	108h
SCK_DriveMode_1_ADDR:	equ	109h
SCK_DriveMode_2_ADDR:	equ	bh
SCK_GlobalSelect_ADDR:	equ	ah
SCK_IntCtrl_0_ADDR:	equ	10ah
SCK_IntCtrl_1_ADDR:	equ	10bh
SCK_IntEn_ADDR:	equ	9h
SCK_MASK:	equ	2h
