;;*****************************************************************************
;;*****************************************************************************
;;  FILENAME: I2CM.inc
;;   Version: 1.4, Updated on 2011/6/28 at 6:9:30
;;  Generated by PSoC Designer 5.1.2306
;;
;;  DESCRIPTION: Assembler declarations for the I2Cm user module interface.
;;
;;-----------------------------------------------------------------------------
;;  Copyright (c) Cypress Semiconductor 2011. All Rights Reserved.
;;*****************************************************************************
;;*****************************************************************************

;--------------------------------------------------
; Constants for I2CM API's
;--------------------------------------------------
;24 MHz
I2CM_delayqtr:     equ   2            ; Define delays for proper timing at 24 MHz
I2CM_delayhalf:    equ   5
I2CM_delay3qtr:    equ   12

;12 MHz
;I2CM_delayqtr:    equ   3
;I2CM_delayhalf:   equ   3
;I2CM_delay3qtr:   equ   3

I2CM_SDA_pin:      equ   1h ; bit number of for SDA
I2CM_SCL_pin:      equ   2h ; bit number of for SCL
I2CM_I2CPortNum:   equ   0h     ; Port number to use for I2C Both pins will be on this port


;-----------------
; Bank 0
;-----------------
I2CM_I2CPRTDR:     equ   PRT0DR  ; Port number to use for I2C Both pins will be on this port

;-----------------
; Bank 1
;-----------------

I2CM_I2CPRTDM0:                        equ   PRT0DM0  ; Port number to use for I2C Both pins will be on this port
I2CM_I2CPRTDM1:                        equ   PRT0DM1  ; Port number to use for I2C Both pins will be on this port

;-----------------
; Misc
;-----------------
I2CM_READ:           equ  0x01 ; Set the R/W flag after the slave address.
I2CM_WRITE:          equ  0x00 ; Clear the R/W flag after the slave address.
I2CM_XFER_ERROR:     equ  0x00 ; Slave did not ACK
I2CM_XFER_COMPLETE:  equ  0x01 ; Returned if Slave did ACK

I2CM_CompleteXfer:   equ  0x00 ; Perform a complete I2C transfer
I2CM_RepStart:       equ  0x01 ; Perform a complete transfer with a Repeat Start
I2CM_NoStop:         equ  0x02 ; Perform a complete transfer, but leave off the stop.

I2CM_NAKslave:       equ  0x00 ; NAK the slave after a read
I2CM_ACKslave:       equ  0x01 ; ACK the slave after a read

; end of file I2CM.inc
