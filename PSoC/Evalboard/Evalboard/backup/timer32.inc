;;*****************************************************************************
;;*****************************************************************************
;;  FILENAME: Timer32.inc
;;   Version: 2.6, Updated on 2011/6/28 at 6:10:10
;;  Generated by PSoC Designer 5.1.2306
;;
;;  DESCRIPTION: Assembler declarations for the Timer32 user module interface
;;-----------------------------------------------------------------------------
;;  Copyright (c) Cypress Semiconductor 2011. All Rights Reserved.
;;*****************************************************************************
;;*****************************************************************************

include "m8c.inc"


;--------------------------------------------------
; Constants for Timer32 API's.
;--------------------------------------------------

Timer32_CONTROL_REG_START_BIT:             equ 0x01    ; Control register start bit
Timer32_INT_REG:                           equ 0x0e1
Timer32_INT_MASK:                          equ 0x08


;--------------------------------------------------
; Constants for Timer32 user defined values
;--------------------------------------------------

Timer32_PERIOD:                            equ 0x7f17
Timer32_COMPARE_VALUE:                     equ 0x0


;--------------------------------------------------
; Register Address Constants for Timer32
;--------------------------------------------------

Timer32_COUNTER_LSB_REG:               equ 0x20   ; DR0 Counter register
Timer32_COUNTER_ISB1_REG:              equ 0x24
Timer32_COUNTER_ISB2_REG:              equ 0x28
Timer32_COUNTER_MSB_REG:               equ 0x2c
Timer32_PERIOD_LSB_REG:                equ 0x21   ; DR1 Period register
Timer32_PERIOD_ISB1_REG:               equ 0x25
Timer32_PERIOD_ISB2_REG:               equ 0x29
Timer32_PERIOD_MSB_REG:                equ 0x2d
Timer32_COMPARE_LSB_REG:               equ 0x22   ; DR2 CompareValue register
Timer32_COMPARE_ISB1_REG:              equ 0x26
Timer32_COMPARE_ISB2_REG:              equ 0x2a
Timer32_COMPARE_MSB_REG:               equ 0x2e
Timer32_CONTROL_LSB_REG:               equ 0x23   ; Control register
Timer32_CONTROL_ISB1_REG:              equ 0x27
Timer32_CONTROL_ISB2_REG:              equ 0x2b
Timer32_CONTROL_MSB_REG:               equ 0x2f
Timer32_FUNC_LSB_REG:                  equ 0x20   ; Function register
Timer32_FUNC_ISB1_REG:                 equ 0x24
Timer32_FUNC_ISB2_REG:                 equ 0x28
Timer32_FUNC_MSB_REG:                  equ 0x2c
Timer32_INPUT_LSB_REG:                 equ 0x21   ; Input register
Timer32_INPUT_ISB1_REG:                equ 0x25
Timer32_INPUT_ISB2_REG:                equ 0x29
Timer32_INPUT_MSB_REG:                 equ 0x2d
Timer32_OUTPUT_LSB_REG:                equ 0x22   ; Output register
Timer32_OUTPUT_ISB1_REG:               equ 0x26
Timer32_OUTPUT_ISB2_REG:               equ 0x2a
Timer32_OUTPUT_MSB_REG:                equ 0x2e


;--------------------------------------------------
; Timer32 Macro 'Functions'
;--------------------------------------------------

   macro Timer32_Start_M
   or    reg[Timer32_CONTROL_LSB_REG],  Timer32_CONTROL_REG_START_BIT
   endm

   macro Timer32_Stop_M
   and   reg[Timer32_CONTROL_LSB_REG], ~Timer32_CONTROL_REG_START_BIT
   endm

   macro Timer32_EnableInt_M
   M8C_EnableIntMask Timer32_INT_REG, Timer32_INT_MASK
   endm

   macro Timer32_DisableInt_M
   M8C_DisableIntMask Timer32_INT_REG, Timer32_INT_MASK
   endm


; end of file Timer32.inc
