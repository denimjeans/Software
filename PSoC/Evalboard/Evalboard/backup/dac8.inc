;;*****************************************************************************
;;*****************************************************************************
;;  FILENAME: DAC8.inc
;;   Version: 2.2, Updated on 2011/6/28 at 6:9:3
;;  Generated by PSoC Designer 5.1.2306
;;
;;  DESCRIPTION:  Assembler declarations for the DAC8 user module interface.
;;-----------------------------------------------------------------------------
;;  Copyright (c) Cypress Semiconductor 2011. All Rights Reserved.
;;*****************************************************************************
;;*****************************************************************************

;--------------------------------------------------
; Constants for DAC8 API's
;--------------------------------------------------

DAC8_OFF:              equ 00h
DAC8_LOWPOWER:         equ 01h
DAC8_MEDPOWER:         equ 02h
DAC8_HIGHPOWER:        equ 03h

DAC8_LSB_CR0:          equ 90h
DAC8_LSB_CR1:          equ 91h
DAC8_LSB_CR2:          equ 92h
DAC8_LSB_CR3:          equ 93h
DAC8_MSB_CR0:          equ 80h
DAC8_MSB_CR1:          equ 81h
DAC8_MSB_CR2:          equ 82h
DAC8_MSB_CR3:          equ 83h

DAC8_OffsetBinary:     equ 04h
DAC8_TwosComplement:   equ 02h
DAC8_SignAndMagnitude: equ 01h
DAC8_RawRegister:      equ 00h

DAC8_DATAFORMAT:       equ 7h
DAC8_OFFSETBINARY:     equ DAC8_DATAFORMAT & DAC8_OffsetBinary
DAC8_TWOSCOMPLEMENT:   equ DAC8_DATAFORMAT & DAC8_TwosComplement
DAC8_SIGNANDMAGNITUDE: equ DAC8_DATAFORMAT & DAC8_SignAndMagnitude

DAC8_PHASE_Normal:     equ 0
DAC8_PHASE_Swapped:    equ 1

DAC8_PHASE_SWAP:       equ DAC8_PHASE_Normal

IF DAC8_PHASE_SWAP
    DAC8_CR0_HIBITS:   equ C0h
ELSE
    DAC8_CR0_HIBITS:   equ 80h
ENDIF

;--------------------------------------------------
; Register Address Constants for DAC8
;--------------------------------------------------
DAC8_LSB_CR0:   equ 90h                          ; LSB SC Block Control Register 0
DAC8_LSB_CR1:   equ 91h                          ; LSB SC Block Control Register 1
DAC8_LSB_CR2:   equ 92h                          ; LSB SC Block Control Register 2
DAC8_LSB_CR3:   equ 93h                          ; LSB SC Block Control Register 3

DAC8_MSB_CR0:   equ 80h                          ; MSB SC Block Control Register 0
DAC8_MSB_CR1:   equ 81h                          ; MSB SC Block Control Register 1
DAC8_MSB_CR2:   equ 82h                          ; MSB SC Block Control Register 2
DAC8_MSB_CR3:   equ 83h                          ; MSB SC Block Control Register 3

; end of file DAC8.inc
