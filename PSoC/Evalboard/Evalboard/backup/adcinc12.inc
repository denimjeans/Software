;;*****************************************************************************
;;*****************************************************************************
;;  FILENAME:   ADCINC12.inc
;;  Version: 5.3, Updated on 2011/6/28 at 6:8:0
;;  Generated by PSoC Designer 5.1.2306
;;
;;  DESCRIPTION:
;;    Assembler declarations for the ACDINC12 user module interface.
;;-----------------------------------------------------------------------------
;;  Copyright (c) Cypress Semiconductor 2011. All Rights Reserved.
;;*****************************************************************************
;;*****************************************************************************


;--------------------------------------------------
; Constants for ADCINC12 API's
;--------------------------------------------------

ADCINC12_TimerIntReg:                       equ  0e1h
ADCINC12_CounterIntReg:                     equ  0e1h

ADCINC12_TimerMask:                         equ  04h
ADCINC12_CounterMask:                       equ  08h

ADCINC12_OFF:                          equ  0
ADCINC12_LOWPOWER:                     equ  1
ADCINC12_MEDPOWER:                     equ  2
ADCINC12_HIGHPOWER:                    equ  3
ADCINC12_NUMBITS:                      equ  12
ADCINC12_NoAZ:                         equ  1
ADCINC12_CNTINPUT:                     equ  ((0 + 4)<<4)
ADCINC12_fDBLK_ENABLE:                 equ  01h      ; Digital block enable bit
ADCINC12_fPULSE_WIDE:                  equ  04h      ; Set to wide terminal count pulse
HighByte:                     equ  0
LowByte:                      equ  1

;--------------------------------------------------
; Registers Address Constants for ADCINC12
;--------------------------------------------------

ADCINC12_AtoDcr0:   equ 80h
ADCINC12_AtoDcr1:   equ 81h
ADCINC12_AtoDcr2:   equ 82h
ADCINC12_AtoDcr3:   equ 83h
ADCINC12_CounterFN: equ 2ch
ADCINC12_CounterSL: equ 2dh
ADCINC12_CounterOS: equ 2eh
ADCINC12_CounterDR0:    equ 2ch
ADCINC12_CounterDR1:    equ 2dh
ADCINC12_CounterDR2:    equ 2eh
ADCINC12_CounterCR0:    equ 2fh
ADCINC12_TimerFN:   equ 28h
ADCINC12_TimerSL:   equ 29h
ADCINC12_TimerOS:   equ 2ah
ADCINC12_TimerDR0:  equ 28h
ADCINC12_TimerDR1:  equ 29h
ADCINC12_TimerDR2:  equ 2ah
ADCINC12_TimerCR0:  equ 2bh

;--------------------------------------------------
; ADCINC12 Macro 'Functions'
;--------------------------------------------------

macro ADCINC12_ISDATA
   mov A,[ADCINC12_fIncr]
   endm

macro ADCINC12_GETDATA
   mov X,[(ADCINC12_iIncr + HighByte)]
   mov A,[(ADCINC12_iIncr + LowByte)]
   endm

macro ADCINC12_CLEARFLAG
   mov [ADCINC12_fIncr],00h
   endm

; End of file ADCINC12.inc



