;;*****************************************************************************
;;*****************************************************************************
;;  FILENAME:   DUALADC.inc
;;  Version: 2.30, Updated on 2012/3/2 at 9:14:34
;;  Generated by PSoC Designer 5.2.2551
;;
;;  DESCRIPTION:  Assembler declarations for the DualADC User Module.
;;-----------------------------------------------------------------------------
;;  Copyright (c) Cypress Semiconductor 2012. All Rights Reserved.
;;*****************************************************************************
;;*****************************************************************************



;--------------------------------------------------
; Constants for DUALADC API's.
;--------------------------------------------------

; Counter1 Constants
DUALADC_bfCounter1_Mask:               equ   01h
DUALADC_bfCounter1_INT_REG:            equ   0e1h

; Counter2 Constants
DUALADC_bfCounter2_Mask:               equ   08h
DUALADC_bfCounter2_INT_REG:            equ   0e1h

; PWM Constants
DUALADC_bfPWM16_Mask:                  equ   04h
DUALADC_bfPWM16_INT_REG:               equ   0e1h

; Power Settings
DUALADC_bfPOWERMASK:                   equ   03h
DUALADC_OFF:                           equ   00h
DUALADC_LOWPOWER:                      equ   01h
DUALADC_MEDPOWER:                      equ   02h
DUALADC_HIGHPOWER:                     equ   03h

; Parameter Settings
DUALADC_bNUMBITS:                      equ   ch
DUALADC_bCALCTIME:                     equ   1h
DUALADC_bMAXRES:                       equ   0Dh      ; Max resolution 13 bits
DUALADC_bMINRES:                       equ   07h      ; Min resolution 7 bits
DUALADC_fCOMPARE_TRUE:                 equ   08h      ; Bit to enable compare True interrupts

; Functionality constants
DUALADC_fFSW0:                         equ   10h      ; Switch Cap FSW0 switch enable
DUALADC_NoAZ:                          equ   01h      ; Set if AutoZero is no enabled
DUALADC_fAutoZero:                     equ   20h      ; Switch Cap AutoZero switch enable
DUALADC_fDBLK_ENABLE:                  equ   01h      ; Digital block enable bit
DUALADC_fPULSE_WIDE:                   equ   04h      ; Enable wide terminal count pulse.

; fStatus definitions
DUALADC_fDATA_READY:                   equ   10h      ; This bit is set when data is available
DUALADC_bRES_MASK:                     equ   0Fh      ; This bit while in integrate cycle

; Data Format
DUALADC_DATA_FORMAT:                   equ   0

; Flag in CR2 register mask
DUALADC_fRES_SET:                      equ   01h

;--------------------------------------------------
; Register Address Contants for DUALADC
;--------------------------------------------------

; TriADC PSoC Block register Definitions
; Integrator1 Block Register Definitions
DUALADC_bfADC1cr0:  equ 80h
DUALADC_bfADC1cr1:  equ 81h
DUALADC_bfADC1cr2:  equ 82h
DUALADC_bfADC1cr3:  equ 83h
; Integrator2 Block Register Definitions
DUALADC_bfADC2cr0:  equ 84h
DUALADC_bfADC2cr1:  equ 85h
DUALADC_bfADC2cr2:  equ 86h
DUALADC_bfADC2cr3:  equ 87h

; Counter1 Block Register Definitions
DUALADC_fCounter1FN:    equ 20h
DUALADC_fCounter1SL:    equ 21h
DUALADC_fCounter1OS:    equ 22h
DUALADC_bCount1:    equ 20h
DUALADC_bPeriod1:   equ 21h
DUALADC_bCompare1:  equ 22h
DUALADC_bCounter1_CR0:  equ 23h

; Counter2 Block Register Definitions
DUALADC_fCounter2FN:    equ 2ch
DUALADC_fCounter2SL:    equ 2dh
DUALADC_fCounter2OS:    equ 2eh
DUALADC_bCount2:    equ 2ch
DUALADC_bPeriod2:   equ 2dh
DUALADC_bCompare2:  equ 2eh
DUALADC_bCounter2_CR0:  equ 2fh


; PWM16 Block Register Definitions
DUALADC_bfPWM_LSB_FN:   equ 24h
DUALADC_bfPWM_MSB_FN:   equ 28h
DUALADC_fPWM_LSB_CR0:   equ 27h
DUALADC_fPWM_MSB_CR0:   equ 2bh
DUALADC_bPWM_Count_MSB: equ 28h
DUALADC_bPWM_Count_LSB: equ 24h
DUALADC_bPWM_Period_MSB:    equ 29h
DUALADC_bPWM_Period_LSB:    equ 25h
DUALADC_bPWM_IntTime_MSB:   equ 2ah
DUALADC_bPWM_IntTime_LSB:   equ 26h
DUALADC_bfPWM_LSB_FN:   equ 24h
DUALADC_bfPWM_MSB_FN:   equ 28h

; end of file DUALADC.inc

