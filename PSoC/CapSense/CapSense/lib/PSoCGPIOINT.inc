;  Generated by PSoC Designer 5.3.2710
;
; CSDCapacitor address and mask equates
CSDCapacitor_Data_ADDR:	equ	0h
CSDCapacitor_DriveMode_0_ADDR:	equ	100h
CSDCapacitor_DriveMode_1_ADDR:	equ	101h
CSDCapacitor_DriveMode_2_ADDR:	equ	3h
CSDCapacitor_GlobalSelect_ADDR:	equ	2h
CSDCapacitor_IntCtrl_0_ADDR:	equ	102h
CSDCapacitor_IntCtrl_1_ADDR:	equ	103h
CSDCapacitor_IntEn_ADDR:	equ	1h
CSDCapacitor_MASK:	equ	2h
CSDCapacitor_MUXBusCtrl_ADDR:	equ	1d8h
; EzI2CsSDA address and mask equates
EzI2CsSDA_Data_ADDR:	equ	4h
EzI2CsSDA_DriveMode_0_ADDR:	equ	104h
EzI2CsSDA_DriveMode_1_ADDR:	equ	105h
EzI2CsSDA_DriveMode_2_ADDR:	equ	7h
EzI2CsSDA_GlobalSelect_ADDR:	equ	6h
EzI2CsSDA_IntCtrl_0_ADDR:	equ	106h
EzI2CsSDA_IntCtrl_1_ADDR:	equ	107h
EzI2CsSDA_IntEn_ADDR:	equ	5h
EzI2CsSDA_MASK:	equ	1h
EzI2CsSDA_MUXBusCtrl_ADDR:	equ	1d9h
; EzI2CsSCL address and mask equates
EzI2CsSCL_Data_ADDR:	equ	4h
EzI2CsSCL_DriveMode_0_ADDR:	equ	104h
EzI2CsSCL_DriveMode_1_ADDR:	equ	105h
EzI2CsSCL_DriveMode_2_ADDR:	equ	7h
EzI2CsSCL_GlobalSelect_ADDR:	equ	6h
EzI2CsSCL_IntCtrl_0_ADDR:	equ	106h
EzI2CsSCL_IntCtrl_1_ADDR:	equ	107h
EzI2CsSCL_IntEn_ADDR:	equ	5h
EzI2CsSCL_MASK:	equ	2h
EzI2CsSCL_MUXBusCtrl_ADDR:	equ	1d9h
; CSDSW1 address and mask equates
CSDSW1_Data_ADDR:	equ	ch
CSDSW1_DriveMode_0_ADDR:	equ	10ch
CSDSW1_DriveMode_1_ADDR:	equ	10dh
CSDSW1_DriveMode_2_ADDR:	equ	fh
CSDSW1_GlobalSelect_ADDR:	equ	eh
CSDSW1_IntCtrl_0_ADDR:	equ	10eh
CSDSW1_IntCtrl_1_ADDR:	equ	10fh
CSDSW1_IntEn_ADDR:	equ	dh
CSDSW1_MASK:	equ	1h
CSDSW1_MUXBusCtrl_ADDR:	equ	1dbh
; CSDSW1_Data access macros
;   GetCSDSW1_Data macro, return in a
macro GetCSDSW1_Data
	mov		a,[Port_3_Data_SHADE]
	and		a, 1h
endm
;   SetCSDSW1_Data macro
macro SetCSDSW1_Data
	or		[Port_3_Data_SHADE], 1h
	mov		a, [Port_3_Data_SHADE]
	mov		reg[CSDSW1_Data_ADDR], a
endm
;   ClearCSDSW1_Data macro
macro ClearCSDSW1_Data
	and		[Port_3_Data_SHADE], ~1h
	mov		a, [Port_3_Data_SHADE]
	mov		reg[CSDSW1_Data_ADDR], a
endm

; CSDSW2 address and mask equates
CSDSW2_Data_ADDR:	equ	ch
CSDSW2_DriveMode_0_ADDR:	equ	10ch
CSDSW2_DriveMode_1_ADDR:	equ	10dh
CSDSW2_DriveMode_2_ADDR:	equ	fh
CSDSW2_GlobalSelect_ADDR:	equ	eh
CSDSW2_IntCtrl_0_ADDR:	equ	10eh
CSDSW2_IntCtrl_1_ADDR:	equ	10fh
CSDSW2_IntEn_ADDR:	equ	dh
CSDSW2_MASK:	equ	2h
CSDSW2_MUXBusCtrl_ADDR:	equ	1dbh
; CSDSW2_Data access macros
;   GetCSDSW2_Data macro, return in a
macro GetCSDSW2_Data
	mov		a,[Port_3_Data_SHADE]
	and		a, 2h
endm
;   SetCSDSW2_Data macro
macro SetCSDSW2_Data
	or		[Port_3_Data_SHADE], 2h
	mov		a, [Port_3_Data_SHADE]
	mov		reg[CSDSW2_Data_ADDR], a
endm
;   ClearCSDSW2_Data macro
macro ClearCSDSW2_Data
	and		[Port_3_Data_SHADE], ~2h
	mov		a, [Port_3_Data_SHADE]
	mov		reg[CSDSW2_Data_ADDR], a
endm

; CSDSW0 address and mask equates
CSDSW0_Data_ADDR:	equ	ch
CSDSW0_DriveMode_0_ADDR:	equ	10ch
CSDSW0_DriveMode_1_ADDR:	equ	10dh
CSDSW0_DriveMode_2_ADDR:	equ	fh
CSDSW0_GlobalSelect_ADDR:	equ	eh
CSDSW0_IntCtrl_0_ADDR:	equ	10eh
CSDSW0_IntCtrl_1_ADDR:	equ	10fh
CSDSW0_IntEn_ADDR:	equ	dh
CSDSW0_MASK:	equ	4h
CSDSW0_MUXBusCtrl_ADDR:	equ	1dbh
; CSDSW0_Data access macros
;   GetCSDSW0_Data macro, return in a
macro GetCSDSW0_Data
	mov		a,[Port_3_Data_SHADE]
	and		a, 4h
endm
;   SetCSDSW0_Data macro
macro SetCSDSW0_Data
	or		[Port_3_Data_SHADE], 4h
	mov		a, [Port_3_Data_SHADE]
	mov		reg[CSDSW0_Data_ADDR], a
endm
;   ClearCSDSW0_Data macro
macro ClearCSDSW0_Data
	and		[Port_3_Data_SHADE], ~4h
	mov		a, [Port_3_Data_SHADE]
	mov		reg[CSDSW0_Data_ADDR], a
endm

; CSDSW3 address and mask equates
CSDSW3_Data_ADDR:	equ	ch
CSDSW3_DriveMode_0_ADDR:	equ	10ch
CSDSW3_DriveMode_1_ADDR:	equ	10dh
CSDSW3_DriveMode_2_ADDR:	equ	fh
CSDSW3_GlobalSelect_ADDR:	equ	eh
CSDSW3_IntCtrl_0_ADDR:	equ	10eh
CSDSW3_IntCtrl_1_ADDR:	equ	10fh
CSDSW3_IntEn_ADDR:	equ	dh
CSDSW3_MASK:	equ	8h
CSDSW3_MUXBusCtrl_ADDR:	equ	1dbh
; CSDSW3_Data access macros
;   GetCSDSW3_Data macro, return in a
macro GetCSDSW3_Data
	mov		a,[Port_3_Data_SHADE]
	and		a, 8h
endm
;   SetCSDSW3_Data macro
macro SetCSDSW3_Data
	or		[Port_3_Data_SHADE], 8h
	mov		a, [Port_3_Data_SHADE]
	mov		reg[CSDSW3_Data_ADDR], a
endm
;   ClearCSDSW3_Data macro
macro ClearCSDSW3_Data
	and		[Port_3_Data_SHADE], ~8h
	mov		a, [Port_3_Data_SHADE]
	mov		reg[CSDSW3_Data_ADDR], a
endm

