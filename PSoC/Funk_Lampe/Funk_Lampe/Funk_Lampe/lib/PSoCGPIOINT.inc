;  Generated by PSoC Designer 5.2.2551
;
; Rx address and mask equates
Rx_Data_ADDR:	equ	0h
Rx_DriveMode_0_ADDR:	equ	100h
Rx_DriveMode_1_ADDR:	equ	101h
Rx_DriveMode_2_ADDR:	equ	3h
Rx_GlobalSelect_ADDR:	equ	2h
Rx_IntCtrl_0_ADDR:	equ	102h
Rx_IntCtrl_1_ADDR:	equ	103h
Rx_IntEn_ADDR:	equ	1h
Rx_MASK:	equ	4h
; Tx address and mask equates
Tx_Data_ADDR:	equ	0h
Tx_DriveMode_0_ADDR:	equ	100h
Tx_DriveMode_1_ADDR:	equ	101h
Tx_DriveMode_2_ADDR:	equ	3h
Tx_GlobalSelect_ADDR:	equ	2h
Tx_IntCtrl_0_ADDR:	equ	102h
Tx_IntCtrl_1_ADDR:	equ	103h
Tx_IntEn_ADDR:	equ	1h
Tx_MASK:	equ	8h
; ADC address and mask equates
ADC_Data_ADDR:	equ	0h
ADC_DriveMode_0_ADDR:	equ	100h
ADC_DriveMode_1_ADDR:	equ	101h
ADC_DriveMode_2_ADDR:	equ	3h
ADC_GlobalSelect_ADDR:	equ	2h
ADC_IntCtrl_0_ADDR:	equ	102h
ADC_IntCtrl_1_ADDR:	equ	103h
ADC_IntEn_ADDR:	equ	1h
ADC_MASK:	equ	20h
; Relais address and mask equates
Relais_Data_ADDR:	equ	4h
Relais_DriveMode_0_ADDR:	equ	104h
Relais_DriveMode_1_ADDR:	equ	105h
Relais_DriveMode_2_ADDR:	equ	7h
Relais_GlobalSelect_ADDR:	equ	6h
Relais_IntCtrl_0_ADDR:	equ	106h
Relais_IntCtrl_1_ADDR:	equ	107h
Relais_IntEn_ADDR:	equ	5h
Relais_MASK:	equ	2h
