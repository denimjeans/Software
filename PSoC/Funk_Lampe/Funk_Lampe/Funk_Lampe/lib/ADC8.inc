;;*****************************************************************************
;;*****************************************************************************
;;  FILENAME:   ADC8.inc
;;  Version: 1.1, Updated on 2012/3/2 at 9:12:17
;;  Generated by PSoC Designer 5.2.2551
;;
;;  DESCRIPTION:
;;    Assembler declarations for the ACDINC12 user module interface.
;;-----------------------------------------------------------------------------
;;  Copyright (c) Cypress Semiconductor 2012. All Rights Reserved.
;;*****************************************************************************
;;*****************************************************************************

;--------------------------------------------------
; Constants for ADC8 API's
;--------------------------------------------------

PWM_High:      equ 8h
PWM_Low:       equ 2h

ADC8_ADCIntReg:                             equ  0e0h
ADC8_ADCMask:                               equ  02h

ADC8_OFF:                              equ  0
ADC8_ON:                               equ  1

;--------------------------------------------------
; Registers Address Constants for ADC8
;--------------------------------------------------

ADC8_LOWRANGE:		                       equ  01h
ADC8_FULLRANGE:                        equ  03h

ADC8_CAL_VBG:		                        equ  03h
ADC8_CAL_AMUXBUS:	                     equ  07h
ADC8_CAL_P0_0:		                       equ  10h
ADC8_CAL_P0_1:		                       equ  90h
ADC8_CAL_P0_2:		                       equ  14h
ADC8_CAL_P0_3:		                       equ  91h
ADC8_CAL_P0_4:		                       equ  18h
ADC8_CAL_P0_5:		                       equ  92h
ADC8_CAL_P0_6:		                       equ  1Ch
ADC8_CAL_P0_7:		                       equ  93h


ADC8_ASE_CR0:   equ 80h
ADC8_ACE_CR1:   equ 72h
ADC8_ACE_CR2:   equ 73h
ADC8_ADC_CR:    equ 68h
ADC8_ADC_TR:    equ e5h

ADC8_CNT_FN:    equ 20h
ADC8_CNT_IN:    equ 21h
ADC8_CNT_OUT:   equ 22h
ADC8_CNT_DR0:   equ 20h
ADC8_CNT_DR1:   equ 21h
ADC8_CNT_DR2:   equ 22h
ADC8_CNT_CR0:   equ 23h


      
