;  Generated by PSoC Designer 5.2.2401
;
; LED7SEGa address and mask equates
LED7SEGa_Data_ADDR:	equ	ch
LED7SEGa_DriveMode_0_ADDR:	equ	10ch
LED7SEGa_DriveMode_1_ADDR:	equ	10dh
LED7SEGa_DriveMode_2_ADDR:	equ	fh
LED7SEGa_GlobalSelect_ADDR:	equ	eh
LED7SEGa_IntCtrl_0_ADDR:	equ	10eh
LED7SEGa_IntCtrl_1_ADDR:	equ	10fh
LED7SEGa_IntEn_ADDR:	equ	dh
LED7SEGa_MASK:	equ	1h
; LED7SEGb address and mask equates
LED7SEGb_Data_ADDR:	equ	ch
LED7SEGb_DriveMode_0_ADDR:	equ	10ch
LED7SEGb_DriveMode_1_ADDR:	equ	10dh
LED7SEGb_DriveMode_2_ADDR:	equ	fh
LED7SEGb_GlobalSelect_ADDR:	equ	eh
LED7SEGb_IntCtrl_0_ADDR:	equ	10eh
LED7SEGb_IntCtrl_1_ADDR:	equ	10fh
LED7SEGb_IntEn_ADDR:	equ	dh
LED7SEGb_MASK:	equ	2h
; LED7SEGc address and mask equates
LED7SEGc_Data_ADDR:	equ	ch
LED7SEGc_DriveMode_0_ADDR:	equ	10ch
LED7SEGc_DriveMode_1_ADDR:	equ	10dh
LED7SEGc_DriveMode_2_ADDR:	equ	fh
LED7SEGc_GlobalSelect_ADDR:	equ	eh
LED7SEGc_IntCtrl_0_ADDR:	equ	10eh
LED7SEGc_IntCtrl_1_ADDR:	equ	10fh
LED7SEGc_IntEn_ADDR:	equ	dh
LED7SEGc_MASK:	equ	4h
; LED7SEGd address and mask equates
LED7SEGd_Data_ADDR:	equ	ch
LED7SEGd_DriveMode_0_ADDR:	equ	10ch
LED7SEGd_DriveMode_1_ADDR:	equ	10dh
LED7SEGd_DriveMode_2_ADDR:	equ	fh
LED7SEGd_GlobalSelect_ADDR:	equ	eh
LED7SEGd_IntCtrl_0_ADDR:	equ	10eh
LED7SEGd_IntCtrl_1_ADDR:	equ	10fh
LED7SEGd_IntEn_ADDR:	equ	dh
LED7SEGd_MASK:	equ	8h
; LED7SEGe address and mask equates
LED7SEGe_Data_ADDR:	equ	ch
LED7SEGe_DriveMode_0_ADDR:	equ	10ch
LED7SEGe_DriveMode_1_ADDR:	equ	10dh
LED7SEGe_DriveMode_2_ADDR:	equ	fh
LED7SEGe_GlobalSelect_ADDR:	equ	eh
LED7SEGe_IntCtrl_0_ADDR:	equ	10eh
LED7SEGe_IntCtrl_1_ADDR:	equ	10fh
LED7SEGe_IntEn_ADDR:	equ	dh
LED7SEGe_MASK:	equ	10h
; LED7SEGf address and mask equates
LED7SEGf_Data_ADDR:	equ	ch
LED7SEGf_DriveMode_0_ADDR:	equ	10ch
LED7SEGf_DriveMode_1_ADDR:	equ	10dh
LED7SEGf_DriveMode_2_ADDR:	equ	fh
LED7SEGf_GlobalSelect_ADDR:	equ	eh
LED7SEGf_IntCtrl_0_ADDR:	equ	10eh
LED7SEGf_IntCtrl_1_ADDR:	equ	10fh
LED7SEGf_IntEn_ADDR:	equ	dh
LED7SEGf_MASK:	equ	20h
; LED7SEGg address and mask equates
LED7SEGg_Data_ADDR:	equ	ch
LED7SEGg_DriveMode_0_ADDR:	equ	10ch
LED7SEGg_DriveMode_1_ADDR:	equ	10dh
LED7SEGg_DriveMode_2_ADDR:	equ	fh
LED7SEGg_GlobalSelect_ADDR:	equ	eh
LED7SEGg_IntCtrl_0_ADDR:	equ	10eh
LED7SEGg_IntCtrl_1_ADDR:	equ	10fh
LED7SEGg_IntEn_ADDR:	equ	dh
LED7SEGg_MASK:	equ	40h
; LED7SEGdp address and mask equates
LED7SEGdp_Data_ADDR:	equ	ch
LED7SEGdp_DriveMode_0_ADDR:	equ	10ch
LED7SEGdp_DriveMode_1_ADDR:	equ	10dh
LED7SEGdp_DriveMode_2_ADDR:	equ	fh
LED7SEGdp_GlobalSelect_ADDR:	equ	eh
LED7SEGdp_IntCtrl_0_ADDR:	equ	10eh
LED7SEGdp_IntCtrl_1_ADDR:	equ	10fh
LED7SEGdp_IntEn_ADDR:	equ	dh
LED7SEGdp_MASK:	equ	80h
; LED7SEGDigit0 address and mask equates
LED7SEGDigit0_Data_ADDR:	equ	10h
LED7SEGDigit0_DriveMode_0_ADDR:	equ	110h
LED7SEGDigit0_DriveMode_1_ADDR:	equ	111h
LED7SEGDigit0_DriveMode_2_ADDR:	equ	13h
LED7SEGDigit0_GlobalSelect_ADDR:	equ	12h
LED7SEGDigit0_IntCtrl_0_ADDR:	equ	112h
LED7SEGDigit0_IntCtrl_1_ADDR:	equ	113h
LED7SEGDigit0_IntEn_ADDR:	equ	11h
LED7SEGDigit0_MASK:	equ	1h
; LED7SEGDigit0_Data access macros
;   GetLED7SEGDigit0_Data macro, return in a
macro GetLED7SEGDigit0_Data
	mov		a,[Port_4_Data_SHADE]
	and		a, 1h
endm
;   SetLED7SEGDigit0_Data macro
macro SetLED7SEGDigit0_Data
	or		[Port_4_Data_SHADE], 1h
	mov		a, [Port_4_Data_SHADE]
	mov		reg[LED7SEGDigit0_Data_ADDR], a
endm
;   ClearLED7SEGDigit0_Data macro
macro ClearLED7SEGDigit0_Data
	and		[Port_4_Data_SHADE], ~1h
	mov		a, [Port_4_Data_SHADE]
	mov		reg[LED7SEGDigit0_Data_ADDR], a
endm

; LED7SEGDigit1 address and mask equates
LED7SEGDigit1_Data_ADDR:	equ	10h
LED7SEGDigit1_DriveMode_0_ADDR:	equ	110h
LED7SEGDigit1_DriveMode_1_ADDR:	equ	111h
LED7SEGDigit1_DriveMode_2_ADDR:	equ	13h
LED7SEGDigit1_GlobalSelect_ADDR:	equ	12h
LED7SEGDigit1_IntCtrl_0_ADDR:	equ	112h
LED7SEGDigit1_IntCtrl_1_ADDR:	equ	113h
LED7SEGDigit1_IntEn_ADDR:	equ	11h
LED7SEGDigit1_MASK:	equ	2h
; LED7SEGDigit1_Data access macros
;   GetLED7SEGDigit1_Data macro, return in a
macro GetLED7SEGDigit1_Data
	mov		a,[Port_4_Data_SHADE]
	and		a, 2h
endm
;   SetLED7SEGDigit1_Data macro
macro SetLED7SEGDigit1_Data
	or		[Port_4_Data_SHADE], 2h
	mov		a, [Port_4_Data_SHADE]
	mov		reg[LED7SEGDigit1_Data_ADDR], a
endm
;   ClearLED7SEGDigit1_Data macro
macro ClearLED7SEGDigit1_Data
	and		[Port_4_Data_SHADE], ~2h
	mov		a, [Port_4_Data_SHADE]
	mov		reg[LED7SEGDigit1_Data_ADDR], a
endm

; LED7SEGDigit2 address and mask equates
LED7SEGDigit2_Data_ADDR:	equ	10h
LED7SEGDigit2_DriveMode_0_ADDR:	equ	110h
LED7SEGDigit2_DriveMode_1_ADDR:	equ	111h
LED7SEGDigit2_DriveMode_2_ADDR:	equ	13h
LED7SEGDigit2_GlobalSelect_ADDR:	equ	12h
LED7SEGDigit2_IntCtrl_0_ADDR:	equ	112h
LED7SEGDigit2_IntCtrl_1_ADDR:	equ	113h
LED7SEGDigit2_IntEn_ADDR:	equ	11h
LED7SEGDigit2_MASK:	equ	4h
; LED7SEGDigit2_Data access macros
;   GetLED7SEGDigit2_Data macro, return in a
macro GetLED7SEGDigit2_Data
	mov		a,[Port_4_Data_SHADE]
	and		a, 4h
endm
;   SetLED7SEGDigit2_Data macro
macro SetLED7SEGDigit2_Data
	or		[Port_4_Data_SHADE], 4h
	mov		a, [Port_4_Data_SHADE]
	mov		reg[LED7SEGDigit2_Data_ADDR], a
endm
;   ClearLED7SEGDigit2_Data macro
macro ClearLED7SEGDigit2_Data
	and		[Port_4_Data_SHADE], ~4h
	mov		a, [Port_4_Data_SHADE]
	mov		reg[LED7SEGDigit2_Data_ADDR], a
endm

; LED7SEGDigit3 address and mask equates
LED7SEGDigit3_Data_ADDR:	equ	10h
LED7SEGDigit3_DriveMode_0_ADDR:	equ	110h
LED7SEGDigit3_DriveMode_1_ADDR:	equ	111h
LED7SEGDigit3_DriveMode_2_ADDR:	equ	13h
LED7SEGDigit3_GlobalSelect_ADDR:	equ	12h
LED7SEGDigit3_IntCtrl_0_ADDR:	equ	112h
LED7SEGDigit3_IntCtrl_1_ADDR:	equ	113h
LED7SEGDigit3_IntEn_ADDR:	equ	11h
LED7SEGDigit3_MASK:	equ	8h
; LED7SEGDigit3_Data access macros
;   GetLED7SEGDigit3_Data macro, return in a
macro GetLED7SEGDigit3_Data
	mov		a,[Port_4_Data_SHADE]
	and		a, 8h
endm
;   SetLED7SEGDigit3_Data macro
macro SetLED7SEGDigit3_Data
	or		[Port_4_Data_SHADE], 8h
	mov		a, [Port_4_Data_SHADE]
	mov		reg[LED7SEGDigit3_Data_ADDR], a
endm
;   ClearLED7SEGDigit3_Data macro
macro ClearLED7SEGDigit3_Data
	and		[Port_4_Data_SHADE], ~8h
	mov		a, [Port_4_Data_SHADE]
	mov		reg[LED7SEGDigit3_Data_ADDR], a
endm

