;;*****************************************************************************
;;*****************************************************************************
;;  FILENAME: I2CHWMMS.inc
;;  Version: 1.90, Updated on 2012/9/21 at 11:59:4
;;  Generated by PSoC Designer 5.3.2710
;;
;;  DESCRIPTION: Assembler declarations for the I2CHW Multi-Master user module 
;;               interface
;;-----------------------------------------------------------------------------
;;  Copyright (c) Cypress Semiconductor 2012. All Rights Reserved.
;;*****************************************************************************
;;*****************************************************************************

;-----------------
; Misc	Flags 
; definitions are provided for information, actual definitions are elsewhere.  Use care with
; flag names, some have similar names but different funcions.  Some are have similar names to the bit definitions
; in the internal I2C_SCR register but are used to pass information between apis and the interrupt.
;-----------------
;I2CHW_READ:                           equ  0x01  ; Set the R/W flag after the slave address.
;I2CHW_WRITE:                          equ  0x00  ; Clear the R/W flag after the slave address.
;I2CHW_XFER_ERROR:                     equ  0x00  ; Slave did not ACK
;
;I2CHW_CompleteXfer:                   equ  0x00  ; Perform a complete I2C transfer
;I2CHW_RepStart:                       equ  0x01  ; Perform a complete transfer with a Repeat Start
;I2CHW_NoStop:                         equ  0x02  ; Perform a complete transfer, but leave off the stop.
;
;I2CHW_NAKslave:                       equ  0x00  ; NAK the slave after a read
;I2CHW_ACKslave:                       equ  0x01  ; ACK the slave after a read

; Flags in I2CHW_bStatus Register

; CAUTION CAUTION CAUTION CAUTION CAUTION CAUTION CAUTION CAUTION CAUTION CAUTION CAUTION CAUTION
; 
; DO NOT USE THESE BITS AS DEFINITIONS FOR CHECKING STATUS AND CONTROL VARIABLES OF THE I2C STATE MACHINE
; THOSE DEFINITIONS ARE CONTAINED IN FILE I2CHW_COMMON.INC THESE ARE REPORTING STATUS VARIABLES 
; NOT STATUS/CONTROL BITS

;reserved bit 0                        equ  0x01  ; Reserved for transfer options  CompleteXfer/RepStart/NoStop
;reserved bit 1						                  equ  0x02  ; Reserved for transfer options, CompleteXfer/RepStart/NoStop

I2CHW_BUS_BUSY:                        equ  0x04  ; Set when the bus is busy
I2CHW_LOST_ARB:                        equ  0x08  ; Set when the master has lost arbitration
I2CHW_BUS_ERROR:                       equ  0x10  ; Set when a bus error has occurred
I2CHW_SLAVE_NAK:                       equ  0x20  ; Set when a slave has failed to respond
I2CHW_ERROR:                           equ  0x40  ; Set when a requested operation failed.
I2CHW_ISR_ACTIVE:                      equ  0x80  ; Set when ISR is active and I2C operation
                                                  ;  is under progress

I2CHW_SLAVE_OPTION:                    equ 1

fMULTIMASTER_NAK_NEXT_WR:              equ  0x80  ; This is a seperate NAK_NEXT_WR for MULTIMASTER_SLAVE_OPERATION

I2CHW_USED_I2C_BLOCK:                  equ   0 ;CY8C28X45 have 0 for I2C Controller_0 and 1 for I2C Controller_1, other have 0


; end of file I2CHWmms.inc
