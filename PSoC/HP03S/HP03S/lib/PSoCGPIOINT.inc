;  Generated by PSoC Designer 5.3.2710
;
; MCLK address and mask equates
MCLK_Data_ADDR:	equ	0h
MCLK_DriveMode_0_ADDR:	equ	100h
MCLK_DriveMode_1_ADDR:	equ	101h
MCLK_DriveMode_2_ADDR:	equ	3h
MCLK_GlobalSelect_ADDR:	equ	2h
MCLK_IntCtrl_0_ADDR:	equ	102h
MCLK_IntCtrl_1_ADDR:	equ	103h
MCLK_IntEn_ADDR:	equ	1h
MCLK_MASK:	equ	8h
; I2CHWSDA address and mask equates
I2CHWSDA_Data_ADDR:	equ	4h
I2CHWSDA_DriveMode_0_ADDR:	equ	104h
I2CHWSDA_DriveMode_1_ADDR:	equ	105h
I2CHWSDA_DriveMode_2_ADDR:	equ	7h
I2CHWSDA_GlobalSelect_ADDR:	equ	6h
I2CHWSDA_IntCtrl_0_ADDR:	equ	106h
I2CHWSDA_IntCtrl_1_ADDR:	equ	107h
I2CHWSDA_IntEn_ADDR:	equ	5h
I2CHWSDA_MASK:	equ	1h
; I2CHWSCL address and mask equates
I2CHWSCL_Data_ADDR:	equ	4h
I2CHWSCL_DriveMode_0_ADDR:	equ	104h
I2CHWSCL_DriveMode_1_ADDR:	equ	105h
I2CHWSCL_DriveMode_2_ADDR:	equ	7h
I2CHWSCL_GlobalSelect_ADDR:	equ	6h
I2CHWSCL_IntCtrl_0_ADDR:	equ	106h
I2CHWSCL_IntCtrl_1_ADDR:	equ	107h
I2CHWSCL_IntEn_ADDR:	equ	5h
I2CHWSCL_MASK:	equ	2h
