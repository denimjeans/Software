;;*****************************************************************************
;;*****************************************************************************
;;  FILENAME: PWM16.inc
;;   Version: 2.5, Updated on 2012/9/21 at 11:59:18
;;  Generated by PSoC Designer 5.3.2710
;;
;;  DESCRIPTION: Assembler declarations for the PWM16 user module interface
;;-----------------------------------------------------------------------------
;;  Copyright (c) Cypress Semiconductor 2012. All Rights Reserved.
;;*****************************************************************************
;;*****************************************************************************

include "m8c.inc"


;--------------------------------------------------
; Constants for PWM16 API's.
;--------------------------------------------------

PWM16_CONTROL_REG_START_BIT:               equ 0x01    ; Control register start bit
PWM16_INT_REG:                             equ 0x0e1
PWM16_INT_MASK:                            equ 0x02


;--------------------------------------------------
; Constants for PWM16 user defined values
;--------------------------------------------------

PWM16_PERIOD:                              equ 0x2d
PWM16_PULSE_WIDTH:                         equ 0x17


;--------------------------------------------------
; Register Address Constants for PWM16
;--------------------------------------------------

PWM16_COUNTER_LSB_REG:                 equ 0x20   ; DR0 Count register
PWM16_COUNTER_MSB_REG:                 equ 0x24
PWM16_PERIOD_LSB_REG:                  equ 0x21   ; DR1 Period register
PWM16_PERIOD_MSB_REG:                  equ 0x25
PWM16_COMPARE_LSB_REG:                 equ 0x22   ; DR2 Compare register
PWM16_COMPARE_MSB_REG:                 equ 0x26
PWM16_CONTROL_LSB_REG:                 equ 0x23   ; Control register
PWM16_CONTROL_MSB_REG:                 equ 0x27
PWM16_FUNC_LSB_REG:                    equ 0x20   ; Function register
PWM16_FUNC_MSB_REG:                    equ 0x24
PWM16_INPUT_LSB_REG:                   equ 0x21   ; Input register
PWM16_INPUT_MSB_REG:                   equ 0x25
PWM16_OUTPUT_LSB_REG:                  equ 0x22   ; Output register
PWM16_OUTPUT_MSB_REG:                  equ 0x26


;--------------------------------------------------
; PWM16 Macro 'Functions'
;--------------------------------------------------

   macro PWM16_Start_M
   or    reg[PWM16_CONTROL_LSB_REG],  PWM16_CONTROL_REG_START_BIT
   endm

   macro PWM16_Stop_M
   and   reg[PWM16_CONTROL_LSB_REG], ~PWM16_CONTROL_REG_START_BIT
   endm

   macro PWM16_EnableInt_M
   M8C_EnableIntMask PWM16_INT_REG, PWM16_INT_MASK
   endm

   macro PWM16_DisableInt_M
   M8C_DisableIntMask PWM16_INT_REG, PWM16_INT_MASK
   endm


; end of file PWM16.inc

