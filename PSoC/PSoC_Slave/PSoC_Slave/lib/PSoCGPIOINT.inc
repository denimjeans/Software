;  Generated by PSoC Designer 5.3.2710
;
; ADC_In address and mask equates
ADC_In_Data_ADDR:	equ	0h
ADC_In_DriveMode_0_ADDR:	equ	100h
ADC_In_DriveMode_1_ADDR:	equ	101h
ADC_In_DriveMode_2_ADDR:	equ	3h
ADC_In_GlobalSelect_ADDR:	equ	2h
ADC_In_IntCtrl_0_ADDR:	equ	102h
ADC_In_IntCtrl_1_ADDR:	equ	103h
ADC_In_IntEn_ADDR:	equ	1h
ADC_In_MASK:	equ	4h
; PWM_Out address and mask equates
PWM_Out_Data_ADDR:	equ	0h
PWM_Out_DriveMode_0_ADDR:	equ	100h
PWM_Out_DriveMode_1_ADDR:	equ	101h
PWM_Out_DriveMode_2_ADDR:	equ	3h
PWM_Out_GlobalSelect_ADDR:	equ	2h
PWM_Out_IntCtrl_0_ADDR:	equ	102h
PWM_Out_IntCtrl_1_ADDR:	equ	103h
PWM_Out_IntEn_ADDR:	equ	1h
PWM_Out_MASK:	equ	20h
; EzI2CsSDA address and mask equates
EzI2CsSDA_Data_ADDR:	equ	4h
EzI2CsSDA_DriveMode_0_ADDR:	equ	104h
EzI2CsSDA_DriveMode_1_ADDR:	equ	105h
EzI2CsSDA_DriveMode_2_ADDR:	equ	7h
EzI2CsSDA_GlobalSelect_ADDR:	equ	6h
EzI2CsSDA_IntCtrl_0_ADDR:	equ	106h
EzI2CsSDA_IntCtrl_1_ADDR:	equ	107h
EzI2CsSDA_IntEn_ADDR:	equ	5h
EzI2CsSDA_MASK:	equ	1h
; EzI2CsSCL address and mask equates
EzI2CsSCL_Data_ADDR:	equ	4h
EzI2CsSCL_DriveMode_0_ADDR:	equ	104h
EzI2CsSCL_DriveMode_1_ADDR:	equ	105h
EzI2CsSCL_DriveMode_2_ADDR:	equ	7h
EzI2CsSCL_GlobalSelect_ADDR:	equ	6h
EzI2CsSCL_IntCtrl_0_ADDR:	equ	106h
EzI2CsSCL_IntCtrl_1_ADDR:	equ	107h
EzI2CsSCL_IntEn_ADDR:	equ	5h
EzI2CsSCL_MASK:	equ	2h
