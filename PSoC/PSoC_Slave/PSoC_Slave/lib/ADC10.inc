;;*****************************************************************************
;;*****************************************************************************
;;  FILENAME:   ADC10.inc
;;  Version: 1.0, Updated on 2006/05/10 at 07:18:37
;;  Generated by PSoC Designer 5.3.2710
;;
;;  DESCRIPTION:
;;    Assembler declarations for the ACDINC12 user module interface.
;;-----------------------------------------------------------------------------
;;  Copyright (c) Cypress Semiconductor 2012. All Rights Reserved.
;;*****************************************************************************
;;*****************************************************************************

;--------------------------------------------------
; Constants for ADC10 API's
;--------------------------------------------------

PWM_High:      equ 28h
PWM_Low:       equ 0h

ADC10_DIE_TEMP_ENABLED:       equ 1h

ADC10_ADCIntReg:                            equ  0e0h
ADC10_ADCClrIntReg:                         equ  0dah
ADC10_ADCMask:                              equ  04h
ADC10_CNTIntReg:                            equ  0e1h
ADC10_CNTClrIntReg:                         equ  0dbh
ADC10_CNTMask:                              equ  04h

ADC10_OFF:                             equ  0
ADC10_ON:                              equ  1

;--------------------------------------------------
; Registers Address Constants for ADC10
;--------------------------------------------------

ADC10_LOWRANGE:                        equ  01h
ADC10_FULLRANGE:                       equ  03h
ADC10_VTEMP_INPUT:                     equ  07h

;--------------------------------------------------
; Deprecated:
ADC10_LOWPOWER:                        equ  01h
ADC10_FULLPOWER:                       equ  03h
;--------------------------------------------------

ADC10_CAL_VBG:                         equ  03h
ADC10_CAL_AMUXBUS:                     equ  07h
ADC10_CAL_P0_0:                        equ  10h
ADC10_CAL_P0_1:                        equ  90h
ADC10_CAL_P0_2:                        equ  14h
ADC10_CAL_P0_3:                        equ  91h
ADC10_CAL_P0_4:                        equ  18h
ADC10_CAL_P0_5:                        equ  92h
ADC10_CAL_P0_6:                        equ  1Ch
ADC10_CAL_P0_7:                        equ  93h

ADC10_COEFFICIENT_M:  equ 293
ADC10_COEFFICIENT_B:  equ 226

ADC10_ASE_CR0:  equ 84h
ADC10_ACE_CR1:  equ 76h
ADC10_ACE_CR2:  equ 77h
ADC10_ADC_CR:   equ 69h
ADC10_ADC_TR:   equ e6h

ADC10_CNT_FN:   equ 28h
ADC10_CNT_IN:   equ 29h
ADC10_CNT_OUT:  equ 2ah
ADC10_CNT_DR0:  equ 28h
ADC10_CNT_DR1:  equ 29h
ADC10_CNT_DR2:  equ 2ah
ADC10_CNT_CR0:  equ 2bh


